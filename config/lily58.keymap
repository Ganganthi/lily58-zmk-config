/*
 * Copyright (c) 2020 The ZMK Contributors
 *
 * SPDX-License-Identifier: MIT
 */

#include <behaviors.dtsi>
#include <dt-bindings/zmk/bt.h>
#include <dt-bindings/zmk/ext_power.h>
#include <dt-bindings/zmk/keys.h>

/ {
    keymap {
        compatible = "zmk,keymap,wired-split";

        default_layer {
            bindings = <
&kp GRAVE       &kp N1  &kp N2  &kp N3            &kp N4    &kp N5                                   &kp N6         &kp N7  &kp N8     &kp N9   &kp N0    &kp MINUS
&kp TAB         &kp Q   &kp W   &kp E             &kp R     &kp T                                    &kp Y          &kp U   &kp I      &kp O    &kp P     &kp EQUAL
&kp CAPSLOCK    &kp A   &kp S   &kp D             &kp F     &kp G                                    &kp H          &kp J   &kp K      &kp L    &kp SEMI  &kp SQT
&kp LEFT_SHIFT  &kp Z   &kp X   &kp C             &kp V     &kp B             &kp LBKT     &kp RBKT  &kp N          &kp M   &kp COMMA  &kp DOT  &kp FSLH  &kp BSLH
                                &kp LEFT_CONTROL  &kp LALT  &kp LEFT_COMMAND  &kp SPACE    &kp RET   &kp BACKSPACE  &mo 1   &kp DEL
            >;
        };

        lower_layer {
            bindings = <
&bt BT_CLR  &bt BT_SEL 0      &bt BT_SEL 1       &bt BT_SEL 2       &bt BT_SEL 3  &bt BT_SEL 4                    &none           &none           &none         &none            &none    &soft_off
&kp F1      &kp F2            &kp F3             &kp F4             &kp F5        &kp F6                          &kp F7          &kp F8          &kp F9        &kp F10          &kp F11  &kp F12
&none       &none             &none              &none              &none         &none                           &kp LEFT_ARROW  &kp DOWN_ARROW  &kp UP_ARROW  &kp RIGHT_ARROW  &none    &none
&none       &ext_power EP_ON  &ext_power EP_OFF  &ext_power EP_TOG  &none         &none         &none     &none   &none           &none           &none         &none            &none    &none
                                                 &trans             &trans        &trans        &trans    &trans  &trans          &trans          &trans
            >;
        };
    };
};

